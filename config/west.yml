## config/west.yml
```yaml
manifest:
  remotes:
  - name: zmkfirmware
    url-base: https://github.com/zmkfirmware
  - name: zmk-keyboards-charybdis
    url-base: https://github.com/badjeff
  projects:
  - name: zmk
    remote: zmkfirmware
    revision: main
    import: app/west.yml
  - name: zmk-charybdis
    url: https://github.com/apetrovic6/zmk-charybdis
    revision: main
    path: modules/zmk-charybdis
  self:
    path: config
```
